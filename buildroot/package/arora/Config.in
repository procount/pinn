## buildroot/package/arora/Config.in
```kconfig
config BR2_PACKAGE_ARORA
        bool "arora"
    select BR2_PACKAGE_QT5
    select BR2_PACKAGE_QT5_WEBKIT
    select BR2_PACKAGE_QT5_GIF
    select BR2_PACKAGE_QT5_QTJPEG
    select BR2_PACKAGE_QT5_QTPNG
        help
          Arora web browser 
```

## buildroot/package/busyboc-dev/Config.in
```kconfig
config BR2_PACKAGE_BUSYBOC-DEV
        bool "busyboc-dev"
    ### build dependencies
    ### runtime dependencies
        help
          Micro Center Busyboc Development
```

## buildroot/package/busyboc/Config.in
```kconfig
config BR2_PACKAGE_BUSYBOC
        bool "busyboc"
    ### build dependencies
    ### runtime dependencies
        help
          busyboc precompiled
```

## buildroot/package/busybocdev/Config.in
```kconfig
config BR2_PACKAGE_BUSYBOCDEV
        bool "busybocdev"
    ### build dependencies
    ### runtime dependencies
        help
          Micro Center Busyboc Development
```

## buildroot/package/busybocdev/Config.in.host
```kconfig
config BR2_PACKAGE_HOST_BUSYBOCDEV
        bool "host busybocdev"
    ### build dependencies
    ### runtime dependencies
        help
          Micro Center Buysboc host development tools
```

## buildroot/package/cipher/Config.in
```kconfig
config BR2_PACKAGE_CIPHER
        bool "cipher"
    ### build dependencies
    ### runtime dependencies
        help
          Create PINN Cipher executable
```

## buildroot/package/compositor/Config.in
```kconfig
config BR2_PACKAGE_COMPOSITOR
        bool "PINN compositor"
        help
          A wayland compositor
```

## buildroot/package/custom/Config.in
```kconfig
config BR2_PACKAGE_CUSTOM
        bool "custom"
    ### build dependencies
    ### runtime dependencies
        help
          custom url provider
```

## buildroot/package/daemon/Config.in
```kconfig
config BR2_PACKAGE_DAEMON
        bool "daemon"
    ### build dependencies
    ### runtime dependencies
        help
          Daemon for teed filter
```

## buildroot/package/daemon/Config.in.host
```kconfig
config BR2_PACKAGE_HOST_DAEMON
        bool "host daemon"
    ### build dependencies
    ### runtime dependencies
        help
          Daemon for teed filter
```

## buildroot/package/mccustom/Config.in
```kconfig
config BR2_PACKAGE_MCCUSTOM
        bool "mccustom"
    ### build dependencies
    ### runtime dependencies
        help
          mccustom url provider
```

## buildroot/package/mccustom/Config.in.host
```kconfig
config BR2_PACKAGE_HOST_MCCUSTOM
        bool "host mccustom"
    ### build dependencies
    ### runtime dependencies
        help
          mccustom host url provider
```

## buildroot/package/mctools/Config.in.host
```kconfig
config BR2_PACKAGE_HOST_MCTOOLS
        bool "host mctools"
    ### build dependencies
    ### runtime dependencies
        help
          Micro center host dev tools
```

## buildroot/package/parted/Config.in
```kconfig
config BR2_PACKAGE_PARTED
	bool "parted"
	select BR2_PACKAGE_UTIL_LINUX
	select BR2_PACKAGE_UTIL_LINUX_LIBUUID
	select BR2_PACKAGE_SCSIFIX
	help
	  parted, the GNU partition resizing program

	  http://www.gnu.org/software/parted/
```

## buildroot/package/rebootp/Config.in
```kconfig
config BR2_PACKAGE_REBOOTP
        bool "rebootp"
    ### build dependencies
    ### runtime dependencies
        help
          reboot PINN to a given partition
```

## buildroot/package/retrogame/Config.in
```kconfig
config BR2_PACKAGE_RETROGAME
        bool "retrogame"
    ### build dependencies
    ### runtime dependencies
        help
          custom url provider
```

## buildroot/package/retrojoy/Config.in
```kconfig
config BR2_PACKAGE_RETROJOY
        bool "retrojoy"
    ### build dependencies
    ### runtime dependencies
        help
          custom url provider
```

## buildroot/package/scsifix/Config.in
```kconfig
config BR2_PACKAGE_SCSIFIX
        bool "scsi header fix"
        help
            fixes missing headers for parted
    
```

## buildroot/package/teed/Config.in
```kconfig
config BR2_PACKAGE_TEED
        bool "teed"
    ### build dependencies
    ### runtime dependencies
        help
          teed filter
```

## buildroot/package/teed/Config.in.host
```kconfig
config BR2_PACKAGE_HOST_TEED
        bool "host teed"
    ### build dependencies
    ### runtime dependencies
        help
          teed filter tool
```
